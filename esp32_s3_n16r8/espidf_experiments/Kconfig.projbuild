## esp32_s3_n16r8/espidf_experiments/Kconfig.projbuild
```kconfig
menu "Acoustic Virtual Sensor board"

config AVS_DEMO_MODE
    bool "Run synthetic serial-only demo (no microphone required)"
    default y

config AVS_USE_ESP_DSP
    bool "Use ESP-DSP optimized FFT and NNLS kernels"
    default n
    help
        Select the parallel ESP-DSP implementation for ESP32-S3. The baseline
        implementation remains available when this option is disabled.

config AVS_I2S_BCLK_GPIO
    int "I2S BCLK GPIO"
    range 0 48
    default 4

config AVS_I2S_WS_GPIO
    int "I2S WS/LRCLK GPIO"
    range 0 48
    default 5

config AVS_I2S_DIN_GPIO
    int "I2S microphone data GPIO"
    range 0 48
    default 6

config AVS_I2S_PORT
    int "I2S controller"
    range 0 1
    default 0

endmenu
```

## esp32_s3_n16r8/main/Kconfig.projbuild
```kconfig
menu "Acoustic Virtual Sensor board"

config AVS_DEMO_MODE
    bool "Run synthetic serial-only demo (no microphone required)"
    default y

config AVS_I2S_BCLK_GPIO
    int "I2S BCLK GPIO"
    range 0 48
    default 4

config AVS_I2S_WS_GPIO
    int "I2S WS/LRCLK GPIO"
    range 0 48
    default 5

config AVS_I2S_DIN_GPIO
    int "I2S microphone data GPIO"
    range 0 48
    default 6

config AVS_I2S_PORT
    int "I2S controller"
    range 0 1
    default 0

endmenu
```
